## http_client/main/Kconfig
```kconfig
menu "Example Configuration"

  config WIFI_SSID
    string "WiFi SSID"
    default "mywifi"
    help
      The SSID of the WiFi network to connect to.

  config WIFI_PASSWORD
    string "WiFi Password"
    default "mypassword"
    help
      The password of the WiFi network to connect to.

endmenu
```

## https_client/main/Kconfig
```kconfig
menu "WiFi Configuration"

  config WIFI_SSID
    string "WiFi SSID"
    default "SSID"
    help
      Enter the SSID of the WiFi network you want to connect to.

  config WIFI_PASSWORD
    string "WiFi Password"
    default "password"
    help
      Enter the password of the WiFi network you want to connect to.

endmenu
```
